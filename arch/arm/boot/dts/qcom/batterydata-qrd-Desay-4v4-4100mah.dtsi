qcom,2312442_wingtech_a12desay_4000mah_averaged_masterslave_feb1st2016 {
			qcom,max-voltage-uv = <4400000>;
			qcom,nom-batt-capacity-mah = <4100>;
			qcom,batt-id-kohm = <30>;
			qcom,battery-beta = <4100>;
			qcom,battery-type = "qrd_msm8937_Desay_4100mah";
			qcom,chg-rslow-comp-c1 = <3278930>;
			qcom,chg-rslow-comp-c2 = <4973220>;
			qcom,chg-rs-to-rslow = <1125247>;
			qcom,chg-rslow-comp-thr = <172>;
			qcom,checksum = <43810>;
			qcom,gui-version = "PMI8950GUI - 2.0.0.15";
			qcom,fg-profile-data = <0xd6835e7c 0xbb809b76 0x64838174 0xa689bc94 0x9d82f391 0xe0af03bb 0x5216fe83 0x7e7d8b81 0xb7c6a83 0x626fb789 0x29954982 0x329ab0bd 0xacb520d 0x1b10b359 0x1470eefc 0x783e7b3f 0xb400000 0x5a46c12b 0x1e2a0000 0x0 0x0 0xba704d6b 0x31637388 0xbf75026b 0xde60ef7b 0xd46e4463 0xd6754fa0 0x1ee460ff 0x5ea0710c 0x2800ff36 0xf0113003 0xc>;
		};

